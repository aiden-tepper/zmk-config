## config/boards/shields/corne/Kconfig.defconfig
```kconfig
if SHIELD_CORNE_LEFT
 
config ZMK_KEYBOARD_NAME
    default "Corne Left"
 
config ZMK_SPLIT
    default y
 
config ZMK_SPLIT_ROLE_CENTRAL
    default n
 
endif
 
if SHIELD_CORNE_RIGHT

config ZMK_KEYBOARD_NAME
    default "Corne Right"

config ZMK_SPLIT
    default y
 
config ZMK_SPLIT_ROLE_CENTRAL
    default n
 
endif
```
